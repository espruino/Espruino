/*
 * This file is part of Espruino, a JavaScript interpreter for Microcontrollers
 *
 * Copyright (C) 2020 Gordon Williams <gw@pur3.co.uk>
 *
 * This Source Code Form is subject to the terms of the Mozilla Public
 * License, v. 2.0. If a copy of the MPL was not distributed with this
 * file, You can obtain one at http://mozilla.org/MPL/2.0/.
 *
 * ----------------------------------------------------------------------------
 * Machine generated vector font header (by build_vector_font.sh)
 * ----------------------------------------------------------------------------
 */

#ifndef NO_VECTOR_FONT
#include "graphics.h"

const uint8_t vfFirstChar = 33;
const uint8_t vfLastChar = 255;
#define VF_CHAR_WIDTH 13
#define VF_SCALE 16
#define VF_OFFSET_Y (-2)
#define VF_CHAR_SPACING 1
static const uint8_t vfPolyVerts[] IN_FLASH_MEMORY = {
  169,171,197,195,
  39,41,145,143,
  39,41,93,91,
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  45,47,73,71
};
static const uint8_t vfPolyLengths[] IN_FLASH_MEMORY = {
  4,4,4,4,4,4,4,4,4,30,4,21,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4
};
static const uint8_t vfCharPolys[] IN_FLASH_MEMORY = {
  0,1,
  2,3,
  4,5,6,7,
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  105,106,92,200
};
static const uint8_t vfCharLengths[] IN_FLASH_MEMORY = {
  2,2,4,2,3,1,1,1,1,3,2,1,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4
};

static const uint8_t *vfGetPolyPtr(unsigned char index, int *polyLen) {
  if (index >= sizeof(vfPolyLengths)) return NULL;

  *polyLen = vfPolyLengths[index];
  const uint8_t *ptr = vfPolyVerts;
  for (unsigned char i=0; i < index; ++i) {
    ptr += vfPolyLengths[i];
  }
  return ptr;
}

static const uint8_t *vfGetCharPtr(char sch, int *charLen) {
  unsigned char ch = (unsigned char)sch;
  if (ch<vfFirstChar || ch>vfLastChar) return NULL;
  ch = (unsigned char)(ch - vfFirstChar);

  const uint8_t *ptr = vfCharPolys;
  for (unsigned char i=0; i < ch; ++i) {
    ptr += vfCharLengths[i];
  }
  *charLen = vfCharLengths[ch];
  return ptr;
}

// prints character, returns width
unsigned int vfDrawCharPtr(JsGraphics *gfx, int x1, int y1, int sizex, int sizey, const uint8_t *charPtr, int charLen) {
  x1 = (x1<<4) - 8;
  y1 = (y1<<4) - 8;
  int w = 0;
  for (int i = 0; i < charLen; ++i) {
    short poly[86];
    int polyLen;
    const uint8_t *p = vfGetPolyPtr(charPtr[i], &polyLen);
    for (int j = 0; j < polyLen; ++j) {
      uint8_t vertex = p[j];
      int vx = vertex % VF_CHAR_WIDTH;
      int vy = vertex / VF_CHAR_WIDTH;
      if (vx>w) w=vx;
      poly[j*2  ] = (short)(x1 + vx*sizex*16/VF_SCALE);
      poly[j*2+1] = (short)(y1 + (vy+VF_OFFSET_Y)*sizey*16/VF_SCALE);
    }
    graphicsFillPoly(gfx, polyLen, poly);
  }
  return (unsigned int)(((w+1+VF_CHAR_SPACING)*sizex*16/VF_SCALE+7)>>4);
}

// returns the width of a character
unsigned int graphicsVectorCharWidth(JsGraphics *gfx, unsigned int sizex, char ch) {
  NOT_USED(gfx);
  int charLen;
  const uint8_t *charPtr = vfGetCharPtr(ch, &charLen);
  if (!charPtr) return (unsigned int)(sizex/2); // space
  int w = 0;
  for (int i = 0; i < charLen; ++i) {
    int polyLen;
    const uint8_t *p = vfGetPolyPtr(charPtr[i], &polyLen);
    for (int j = 0; j < polyLen; ++j) {
      uint8_t vertex = p[j];
      int vx = vertex % VF_CHAR_WIDTH;
      if (vx>w) w=vx;
    }
  }
  return ((unsigned int)(w+1+VF_CHAR_SPACING)*sizex*16/VF_SCALE+7)>>4;
}

// prints character, returns width
unsigned int graphicsFillVectorChar(JsGraphics *gfx, int x1, int y1, int sizex, int sizey, char ch) {
  int charLen;
  const uint8_t *charPtr = vfGetCharPtr(ch, &charLen);
  if (!charPtr) return (unsigned int)(sizex/2); // space
  return vfDrawCharPtr(gfx, x1, y1, sizex, sizey, charPtr, charLen);
}

#endif
