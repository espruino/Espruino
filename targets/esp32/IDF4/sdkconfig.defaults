## targets/esp32/IDF4/sdkconfig.defaults
```kconfig
# ESP32 - IDF 4.4.8 - Espruino ESP32 custom

CONFIG_ESPTOOLPY_FLASHSIZE_4MB=y
CONFIG_COMPILER_OPTIMIZATION_RELEASE=y

CONFIG_PARTITION_TABLE_CUSTOM=y
#CONFIG_PARTITION_TABLE_CUSTOM_FILENAME="partitions.csv"
#CONFIG_PARTITION_TABLE_FILENAME="partitions.csv"

CONFIG_APP_BUILD_TYPE_APP_2NDBOOT=y
CONFIG_BT_ENABLED=y
CONFIG_ETH_ENABLED=y
#CONFIG_ESP32_WIFI_DYNAMIC_RX_BUFFER_NUM=32
CONFIG_FMB_COMM_MODE_RTU_EN=y
CONFIG_SPIFFS_USE_MTIME=y

# WIFI 
#cd bCONFIG_ESP32_WIFI_STATIC_RX_BUFFER_NUM=5     # Was 10 → 5
#CONFIG_ESP32_WIFI_DYNAMIC_RX_BUFFER_NUM=16   # Was 32 → 16

#default is info
CONFIG_LOG_DEFAULT_LEVEL_ERROR=y

# -Os flag (Optimize for SIZE)
CONFIG_COMPILER_OPTIMIZATION_SIZE=y
# -O2 flag (Optimize for PERFORMANCE)
#CONFIG_COMPILER_OPTIMIZATION_LEVEL_RELEASE=y

# Disable asserts for production:
CONFIG_COMPILER_OPTIMIZATION_ASSERTIONS_DISABLE=y
# Enable asserts for testing

#CONFIG_COMPILER_OPTIMIZATION_ASSERTIONS_ENABLE=y
#CONFIG_COMPILER_OPTIMIZATION_ASSERTION_LEVEL=2
```

## targets/esp32/IDF5/sdkconfig.defaults.esp32c3
```kconfig
# sdkconfig.defaults.esp32c3
CONFIG_IDF_TARGET="esp32c3"
CONFIG_IDF_TARGET_ESP32C3=y
CONFIG_ESP_CONSOLE_SECONDARY_USB_SERIAL_JTAG=y
CONFIG_APP_RETRIEVE_LEN_ELF_SHA=16
CONFIG_ESPTOOLPY_FLASHSIZE_4MB=y
CONFIG_BT_BLE_42_FEATURES_SUPPORTED=y
CONFIG_BT_CTRL_HW_CCA_VAL=20
CONFIG_TWAI_ERRATA_FIX_LISTEN_ONLY_DOM=n
CONFIG_ESP_TASK_WDT_INIT=n
CONFIG_ESP_IPC_TASK_STACK_SIZE=1536
CONFIG_ESP_WIFI_GMAC_SUPPORT=n
CONFIG_LOG_COLORS=y
CONFIG_MBEDTLS_DYNAMIC_BUFFER=y
# Disable all possible WDT config items
CONFIG_INT_WDT=n
CONFIG_ESP_TASK_WDT=n
```

## targets/esp32/IDF5/sdkconfig.defaults.esp32s3
```kconfig
CONFIG_IDF_TARGET="esp32s3"
CONFIG_IDF_TARGET_ESP32S3=y
CONFIG_ESP_DEFAULT_CPU_FREQ_MHZ_240=y
CONFIG_ESP_CONSOLE_SECONDARY_USB_SERIAL_JTAG=y

CONFIG_APP_RETRIEVE_LEN_ELF_SHA=16
CONFIG_ESPTOOLPY_FLASHSIZE_8MB=y

CONFIG_BT_BLE_42_FEATURES_SUPPORTED=y
CONFIG_BT_CTRL_HW_CCA_VAL=20
CONFIG_BT_CONTROLLER_ENABLED=y
CONFIG_BT_BLUEDROID_ENABLED=n
CONFIG_BT_HOST=n


CONFIG_TWAI_ERRATA_FIX_LISTEN_ONLY_DOM=n
CONFIG_ESP_HTTP_CLIENT_ENABLE_DIGEST_AUTH=y
CONFIG_HTTPD_MAX_REQ_HDR_LEN=512
CONFIG_ESP_SLEEP_POWER_DOWN_FLASH=y
CONFIG_ESP_SLEEP_FLASH_LEAKAGE_WORKAROUND=n

CONFIG_ESP_INT_WDT=n
CONFIG_ESP_TASK_WDT_INIT=n
CONFIG_ESP_IPC_TASK_STACK_SIZE=1536
CONFIG_ESP_WIFI_GMAC_SUPPORT=n
CONFIG_FREERTOS_HZ=1000
CONFIG_LOG_COLORS=y
```

## targets/zephyr/boards/arm/banglejs3/Kconfig.banglejs3
```kconfig
# Copyright (c) 2024 Nordic Semiconductor ASA
# SPDX-License-Identifier: Apache-2.0

config BOARD_BANGLEJS3
	select SOC_NRF54L15_CPUAPP 
```

## targets/zephyr/boards/arm/banglejs3/Kconfig.defconfig
```kconfig
# Copyright (c) 2024 Nordic Semiconductor ASA
# SPDX-License-Identifier: Apache-2.0

config HW_STACK_PROTECTION
	default ARCH_HAS_STACK_PROTECTION

if SPI_NOR

config SPI_NOR_FLASH_LAYOUT_PAGE_SIZE
	default 4096 if MCUBOOT || BOOTLOADER_MCUBOOT

endif # SPI_NOR


config BOARD_BANGLEJS3
	select USE_DT_CODE_PARTITION

config HAS_BT_CTLR
	default BT

# By default, if we build for a Non-Secure version of the board,
# enable building with TF-M as the Secure Execution Environment.
config BUILD_WITH_TFM
	default n
```

## targets/zephyr/boards/arm/banglejs3/board.yml
```yaml
board:
  name: banglejs3
  full_name: nRF54L15 DK
  vendor: nordic
  socs:
    - name: nrf54l15
runners:
  run_once:
    '--recover':
      - runners:
          - nrfjprog
          - nrfutil
        run: first
        groups:
          - boards:
              - banglejs3/nrf54l15/cpuapp
    '--erase':
      - runners:
          - nrfjprog
          - jlink
          - nrfutil
        run: first
        groups:
          - boards:
              - banglejs3/nrf54l15/cpuapp
    '--reset':
      - runners:
          - nrfjprog
          - jlink
          - nrfutil
        run: last
        groups:
          - boards:
              - banglejs3/nrf54l15/cpuapp
```
